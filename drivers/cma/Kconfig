## drivers/cma/Kconfig
```kconfig
config CMA_MALLOC
	tristate "CMA driver"

	help
        This implements a contiguous memory allocator driver
```

## drivers/crossconenclave/Kconfig
```kconfig
config CROSSCON_ENCLAVE
	tristate "CROSSCON Hypervisor Enclave support"

	help
        This implements a communication interface between the linux guest and the CROSSCON Hypervisor to create and manage CROSSCON enclaves.
```

## drivers/crossconipc/Kconfig
```kconfig
config CROSSCONHYP_SHMEM
	tristate "CROSSCON Hypervisor shared memory support"

	help
	  This implements an interface to communicate with CROSSCON Hypervisor hosted guests.
```
